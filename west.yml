## west.yml
```yaml
manifest:
  remotes:
    - name: akadimia-embedded
      url-base: https://github.com/akadimiaembedded

  projects:
    - name: akadimia-sdk
      remote: akadimia-embedded
      revision: main
      path: akadimia-sdk
      import: true
      
  self:
    path: .
```
