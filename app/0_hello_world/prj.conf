## CMakeLists.txt
```
# Copyright (c) 2025 liangyq <liangyongqincn@gmail.com>
# 
# SPDX-License-Identifier: Apache-2.0

cmake_minimum_required(VERSION 3.20.0)

find_package(Zephyr REQUIRED HINTS $ENV{ZEPHYR_BASE})
project(hello_world)

target_sources(app PRIVATE src/main.c)
```

## sample.yaml
```
sample:
  description: Hello World sample, the simplest Zephyr
    application
  name: akadimia hello world
common:
  tags: introduction
  integration_platforms:
    - native_sim
  harness: console
  harness_config:
    type: one_line
    regex:
      - "Hello World! (.*)"
tests:
  sample.basic.helloworld:
    tags: introduction
```

## prj.conf
```kconfig
# Copyright (c) 2025 liangyq <liangyongqincn@gmail.com>
# 
# SPDX-License-Identifier: Apache-2.0

# gpio
CONFIG_GPIO=y

# serial
CONFIG_SERIAL=y

# console
CONFIG_CONSOLE=y
CONFIG_UART_CONSOLE=y
```

## boards/aka_stm32f429igt6.conf
```kconfig
# gpio
CONFIG_GPIO=y

# serial
CONFIG_SERIAL=y

# console
CONFIG_CONSOLE=y
CONFIG_UART_CONSOLE=y
```

## src/main.c
```c
/*
 * Copyright (c) 2025 liangyq <liangyongqincn@gmail.com>
 *
 * SPDX-License-Identifier: Apache-2.0
 */

#include <stdio.h>

int main(void)
{
	printf("Hello World! %s\n", CONFIG_BOARD_TARGET);

	return 0;
}
```
